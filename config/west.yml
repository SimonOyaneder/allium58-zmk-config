## config/west.yml
```yaml
manifest:
  remotes:
    - name: zmkfirmware
      url-base: https://github.com/zmkfirmware
  projects:
    - name: zmk
      remote: zmkfirmware
      revision: main
      import: app/west.yml
  # El shield de las pantallas ya no viene de un módulo externo: vive en
  # boards/shields/nice_view_gem (copia de M165437/nice-view-gem adaptada
  # con arte custom en ambas mitades). Tenerlo aquí además duplicaría el shield.
  self:
    path: config
```
